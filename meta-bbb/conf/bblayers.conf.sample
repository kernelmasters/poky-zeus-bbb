## meta-bbb/conf/bblayers.conf.sample
```bitbake
# POKY_BBLAYERS_CONF_VERSION is increased each time build/conf/bblayers.conf
# changes incompatibly
POKY_BBLAYERS_CONF_VERSION = "2"

BBPATH = "${TOPDIR}"
BBFILES ?= ""

BBLAYERS ?= " \
  ${HOME}/poky-zeus-bbb/meta \
  ${HOME}/poky-zeus-bbb/meta-poky \
  ${HOME}/poky-zeus-bbb/meta-openembedded/meta-oe \
  ${HOME}/poky-zeus-bbb/meta-openembedded/meta-networking \
  ${HOME}/poky-zeus-bbb/meta-openembedded/meta-perl \
  ${HOME}/poky-zeus-bbb/meta-openembedded/meta-python \
  ${HOME}/poky-zeus-bbb/meta-qt5 \
  ${HOME}/poky-zeus-bbb/meta-security \
  ${HOME}/poky-zeus-bbb/meta-jumpnow \
  ${HOME}/poky-zeus-bbb/meta-bbb \
  ${HOME}/poky-zeus-bbb/meta-km-bbb \
"
```

## meta-km-bbb/conf/layer.conf
```bitbake
# We have a conf and classes directory, add to BBPATH
BBPATH .= ":${LAYERDIR}"

# We have recipes-* directories, add to BBFILES
BBFILES += "${LAYERDIR}/recipes-*/*/*.bb \
            ${LAYERDIR}/recipes-*/*/*.bbappend"

BBFILE_COLLECTIONS += "meta-km-bbb"
BBFILE_PATTERN_meta-km-bbb = "^${LAYERDIR}/"
BBFILE_PRIORITY_meta-km-bbb = "17"

LAYERDEPENDS_meta-km-bbb = "core"
LAYERSERIES_COMPAT_meta-km-bbb = "warrior zeus"
```
